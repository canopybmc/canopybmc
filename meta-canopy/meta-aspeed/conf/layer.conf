## meta-canopy/meta-aspeed/conf/layer.conf
```bitbake
BBPATH .= ":${LAYERDIR}"

BBFILES += "${LAYERDIR}/recipes-*/*/*.bb \
            ${LAYERDIR}/recipes-*/*/*.bbappend"

BBFILE_COLLECTIONS += "canopy-aspeed-layer"
BBFILE_PATTERN_canopy-aspeed-layer = "^${LAYERDIR}/"
BBFILE_PRIORITY_canopy-aspeed-layer = "12"
LAYERSERIES_COMPAT_canopy-aspeed-layer = "wrynose whinlatter"
```

## meta-canopy/meta-aspeed/conf/machine/ast2700-a1-dcscm.conf
```bitbake
#@TYPE: Machine
#@NAME: ASPEED AST2700 A1 DC-SCM
#@DESCRIPTION: Hostless single-node AST2700 A1 DC-SCM reference card.

require conf/machine/include/ast2700-sdk.inc
require conf/machine/include/ast2700-a1.inc
require conf/machine/include/ast-ssp.inc
require conf/machine/include/ast-tsp.inc
require conf/machine/include/obmc-bsp-common.inc

FLASH_SIZE = "131072"
FLASH_UBOOT_OFFSET:flash-131072 = "0"
FLASH_CALIPTRA_SIZE:flash-131072 = "128"
FLASH_BMCU_SIZE:flash-131072 = "896"
FLASH_UBOOT_ENV_OFFSET:flash-131072 = "4096"
FLASH_KERNEL_OFFSET:flash-131072 = "4224"
FLASH_ROFS_OFFSET:flash-131072 = "16512"
FLASH_RWFS_OFFSET:flash-131072 = "98304"

CALIPTRA_FW_BINARY = "caliptra-fw.bin"
CPTRA_TOML_CALIPTRA_RUNTIME = ""
CPTRA_TOML_MCU_RUNTIME = ""
CPTRA_TOML_IMG_MCU = ""

FMC_IMAGE_ENABLE = "1"
BOOTMCU_FMC_BINARY = "ast2700-mcu-runtime.bin"
ZEPHYR_BOARD_BOOTMCU = "ast2700_evb/ast2700_a1/bootmcu"
ZEPHYR_BOARD_SSP = "ast2700_evb/ast2700_a1/ssp_tsp"
ZEPHYR_BOARD_TSP = "ast2700_evb/ast2700_a1/tsp"

PREFERRED_PROVIDER_virtual/bootloader = "u-boot-aspeed"
PREFERRED_PROVIDER_u-boot = "u-boot-aspeed"
PREFERRED_PROVIDER_u-boot-fw-utils = "libubootenv"
UBOOT_MACHINE = "evb-ast2700_defconfig"

# aspeed-sdk.inc adds runqemu support, which would build QEMU for every image
IMAGE_CLASSES:remove = "qemuboot"
EXTRA_IMAGEDEPENDS:remove = "qemu-helper-native"

KBUILD_DEFCONFIG = "aspeed_g7_defconfig"
KERNEL_DEVICETREE = "aspeed/ast2700-a1-dcscm.dtb"

MACHINE_FEATURES += "\
        obmc-phosphor-flash-mgmt \
        obmc-bmc-state-mgmt \
        "

OBMC_HOST_INSTANCES = ""
OBMC_CHASSIS_INSTANCES = ""
VIRTUAL-RUNTIME_obmc-fan-presence = ""
```

## meta-canopy/meta-aspeed/conf/machine/ast2700a1dcscm.conf
```bitbake
#@TYPE: Machine
#@NAME: Canopy AST2700 A1 DC-SCM
#@DESCRIPTION: Hostless AST2700 A1 single-node DC-SCM.

require conf/machine/include/ast2700-sdk.inc
require conf/machine/include/ast2700-a1.inc
require conf/machine/include/canopy-ast2700-dcscm.inc

FLASH_CALIPTRA_SIZE:flash-65536 = "128"
FLASH_BMCU_SIZE:flash-65536 = "896"

CALIPTRA_FW_BINARY = "caliptra-fw.bin"
CPTRA_TOML_CALIPTRA_RUNTIME = ""
CPTRA_TOML_MCU_RUNTIME = ""
CPTRA_TOML_IMG_MCU = ""

FMC_IMAGE_ENABLE = "1"
BOOTMCU_FMC_BINARY = "ast2700-mcu-runtime.bin"
ZEPHYR_BOARD_BOOTMCU = "ast2700_evb/ast2700_a1/bootmcu"
ZEPHYR_BOARD_SSP = "ast2700_evb/ast2700_a1/ssp_tsp"
ZEPHYR_BOARD_TSP = "ast2700_evb/ast2700_a1/tsp"

KERNEL_DEVICETREE = "aspeed/ast2700a1dcscm.dtb"
```

## meta-canopy/meta-aspeed/conf/machine/ast2700dcscm.conf
```bitbake
#@TYPE: Machine
#@NAME: Canopy AST2700 DC-SCM
#@DESCRIPTION: Hostless AST2700 A2 single-node DC-SCM.

require conf/machine/include/ast2700-sdk.inc
require conf/machine/include/canopy-ast2700-dcscm.inc

CALIPTRA_FW_BINARY = "caliptra-fw-v2.bin"
BOOTMCU_FW_BINARY = "ast2700-mcu-runtime.bin"
KERNEL_DEVICETREE = "aspeed/ast2700dcscm.dtb"
```

## meta-canopy/meta-aspeed/conf/machine/include/canopy-ast2700-dcscm.inc
```bitbake
MACHINEOVERRIDES =. "canopy-ast2700-dcscm:"

require conf/machine/include/ast-ssp.inc
require conf/machine/include/ast-tsp.inc
require conf/machine/include/ast2700-secure-customize-gen.inc
require conf/machine/include/obmc-bsp-common.inc

ASPEED_CUSTOMIZE_GEN_SECURE_IMAGE_ENABLE = "0"

# 64 MiB BMC flash layout.
FLASH_SIZE = "65536"
FLASH_UBOOT_OFFSET:flash-65536 = "0"
FLASH_UBOOT_ENV_OFFSET:flash-65536 = "4096"
FLASH_KERNEL_OFFSET:flash-65536 = "4224"
FLASH_ROFS_OFFSET:flash-65536 = "13440"
FLASH_RWFS_OFFSET:flash-65536 = "50944"

UBOOT_MACHINE = "evb-ast2700_defconfig"
UBOOT_DEVICETREE = "ast2700-dcscm"

KBUILD_DEFCONFIG = "aspeed_g7_defconfig"

MACHINE_FEATURES += "\
        obmc-phosphor-flash-mgmt \
        obmc-bmc-state-mgmt \
        "

OBMC_HOST_INSTANCES = ""
OBMC_CHASSIS_INSTANCES = ""
VIRTUAL-RUNTIME_obmc-fan-presence = ""

EXTRA_IMAGEDEPENDS:append = " \
    aspeed-image-recoveryuart \
    "
```

## meta-canopy/meta-hpe/conf/machine/include/proliant-g11.inc
```bitbake
GXP_BOARD_MAP = "\
    0x0235:dl360gen11 \
    0x0236:dl380gen11 \
    0x0241:dl560gen11 \
    0x0243:dl385gen11 \
    0x0244:dl325gen11 \
    0x0245:dl365gen11 \
    0x0246:dl345gen11 \
    0x0248:dl110gen11 \
    0x0249:dl320gen11 \
    0x024a:dl380agen11 \
    0x0250:rl300gen11 \
    0x0261:dl340gen11plus \
    0x0263:dl320gen11plus \
    0x0264:dl320gen12 \
    0x0271:dl145gen11 \
    0x0273:dl340gen12 \
"

KERNEL_DEVICETREE ?= "\
    hpe/hpe-bmc-dl360gen11.dtb \
    hpe/hpe-bmc-dl380gen11.dtb \
    hpe/hpe-bmc-dl560gen11.dtb \
    hpe/hpe-bmc-dl385gen11.dtb \
    hpe/hpe-bmc-dl325gen11.dtb \
    hpe/hpe-bmc-dl365gen11.dtb \
    hpe/hpe-bmc-dl345gen11.dtb \
    hpe/hpe-bmc-dl110gen11.dtb \
    hpe/hpe-bmc-dl320gen11.dtb \
    hpe/hpe-bmc-dl380agen11.dtb \
    hpe/hpe-bmc-rl300gen11.dtb \
    hpe/hpe-bmc-dl340gen11plus.dtb \
    hpe/hpe-bmc-dl320gen11plus.dtb \
    hpe/hpe-bmc-dl320gen12.dtb \
    hpe/hpe-bmc-dl145gen11.dtb \
    hpe/hpe-bmc-dl340gen12.dtb \
"

# bootblock loader variants in use
HPE_GXP_LOADERS = "\
  GXP2loader-t277-t280-t285-sgn00 \
  GXP2loader-t282-t288-sgn00 \
  GXP2loader-t26x-sgn00 \
"

# Map each loader to gen11 model names
HPE_GXP_LOADER_MODELS[GXP2loader-t277-t280-t285-sgn00] = "\
  dl320-g11 \
  dl325-g11 \
  dl360-g11 \
  dl365-g11 \
  dl380-g11 \
  dl385-g11 \
"
HPE_GXP_LOADER_MODELS[GXP2loader-t26x-sgn00] = "\
  rl300-g11 \
"

EXTRA_IMAGECMD:squashfs-xz ?= " -b 1M -Xbcj armthumb"

require conf/machine/include/gxp.inc
require conf/machine/include/obmc-bsp-common.inc
```
