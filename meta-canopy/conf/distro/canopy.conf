## meta-canopy/conf/distro/canopy.conf
```bitbake
require conf/distro/openbmc-phosphor.conf
require conf/distro/include/phosphor-isolation.inc

DISTRO = "canopy"
DISTRO_NAME = "CanopyBMC (based on Phosphor OpenBMC)"
DISTROOVERRIDES .= ":canopy"

# Build channels:
# dev               - Usually with debug tooling and more.
# release (default) - For production
#
CANOPY_CONFIG ?= "release"
OVERRIDES .= ":${CANOPY_CONFIG}:"

# Optional free-form tag appended to the version (e.g. "mybranch").
CANOPY_CUSTOM_TAG ?= ""

IMAGE_FEATURES:append = " allow-root-login"

# from meta-phosphor/conf/distro/include/phosphor-production.inc
# a conditional require/include is not possible in Yocto, unfortunately.
DISTRO_FEATURES:append:canopy:release = "phosphor-production"
DISTROOVERRIDES:append:canopy:release = ":df-phosphor-production"
```

## meta-canopy/conf/layer.conf
```bitbake
# We have a conf and classes directory, add to BBPATH
BBPATH .= ":${LAYERDIR}"

# We have recipes-* directories, add to BBFILES
BBFILES += "${LAYERDIR}/recipes-*/*/*.bb \
            ${LAYERDIR}/recipes-*/*/*.bbappend"

BBFILE_COLLECTIONS += "canopy-layer"
BBFILE_PATTERN_canopy-layer = "^${LAYERDIR}/"
BBFILE_PRIORITY_canopy-layer = "10"
LAYERSERIES_COMPAT_canopy-layer = "walnascar"
```

## meta-canopy/conf/machine/canopy-qemu.conf
```bitbake
# Canopy QEMU machine
#
# Emulates an AST2600 EVB to test Canopy customizations (WebUI branding,
# etc.) without physical hardware.  The HPE GXP layers are intentionally
# excluded — only the top-level canopy-layer is active.

KERNEL_DEVICETREE = "aspeed/aspeed-ast2600-evb.dtb"

UBOOT_MACHINE = "ast2600_openbmc_spl_defconfig"
UBOOT_DEVICETREE = "ast2600-evb"
SPL_BINARY = "spl/u-boot-spl.bin"
SOCSEC_SIGN_ENABLE = "0"

require conf/machine/include/ast2600.inc
require conf/machine/include/obmc-bsp-common.inc
include conf/machine/include/obmc-evb-common.inc

SERIAL_CONSOLES = "115200;ttyS4"

# AST2600 EVB default: 64 MB SPI flash
FLASH_SIZE = "65536"

# Use the Aspeed kernel, not the Canopy GXP kernel
PREFERRED_PROVIDER_virtual/kernel = "linux-aspeed"
```

## meta-canopy/meta-asus/conf/machine/include/asus.inc
```bitbake
MACHINE_FEATURES += "\
    obmc-phosphor-chassis-mgmt \
    obmc-phosphor-fan-mgmt \
    obmc-phosphor-flash-mgmt \
    obmc-host-state-mgmt \
    obmc-chassis-state-mgmt \
    obmc-bmc-state-mgmt \
    obmc-host-ipmi\
    "

VIRTUAL-RUNTIME_obmc-inventory-manager = "entity-manager"
PREFERRED_PROVIDER_virtual/obmc-inventory-data = "entity-manager"

VIRTUAL-RUNTIME_obmc-host-state-manager ?= "x86-power-control"
VIRTUAL-RUNTIME_obmc-chassis-state-manager ?= "x86-power-control"
VIRTUAL-RUNTIME_obmc-sensors-hwmon = "dbus-sensors"
VIRTUAL-RUNTIME_obmc-fan-control = "phosphor-pid-control"

PREFERRED_PROVIDER_virtual/obmc-chassis-mgmt = "packagegroup-asus-apps"
PREFERRED_PROVIDER_virtual/obmc-fan-mgmt = "packagegroup-asus-apps"
PREFERRED_PROVIDER_virtual/obmc-flash-mgmt = "packagegroup-asus-apps"
PREFERRED_PROVIDER_virtual/obmc-system-mgmt = "packagegroup-asus-apps"

PREFERRED_PROVIDER_virtual/obmc-host-ipmi-hw ?= "phosphor-ipmi-kcs"
```

## meta-canopy/meta-asus/meta-kommando-ipmi-card/conf/layer.conf
```bitbake
# We have a conf and classes directory, add to BBPATH
BBPATH .= ":${LAYERDIR}"

# We have recipes-* directories, add to BBFILES
BBFILES += "${LAYERDIR}/recipes-*/*/*.bb \
            ${LAYERDIR}/recipes-*/*/*.bbappend"

BBFILE_COLLECTIONS += "kommando-ipmi-card-layer"
BBFILE_PATTERN_kommando-ipmi-card-layer = "^${LAYERDIR}/"
BBFILE_PRIORITY_kommando-ipmi-card-layer = "6"

LAYERDEPENDS_kommando-ipmi-card-layer = "core"
LAYERSERIES_COMPAT_kommando-ipmi-card-layer = "wrynose whinlatter"
```

## meta-canopy/meta-asus/meta-kommando-ipmi-card/conf/machine/kommando-ipmi-card.conf
```bitbake
KMACHINE = "aspeed"
KERNEL_DEVICETREE = "aspeed/${KMACHINE}-bmc-asus-${MACHINE}.dtb"

UBOOT_MACHINE = "ast2600_openbmc_spl_defconfig"
UBOOT_DEVICETREE = "ast2600-asus-kommando-ipmi-card"
SPL_BINARY = "spl/u-boot-spl.bin"

SOCSEC_SIGN_ENABLE = "0"
FLASH_SIZE = "65536"

VIRTUAL-RUNTIME_obmc-fan-control = "phosphor-pid-control"
VIRTUAL-RUNTIME_obmc-sensors-hwmon = "dbus-sensors"

require conf/machine/include/ast2600.inc
require conf/machine/include/obmc-bsp-common.inc
require conf/machine/include/asus.inc
```

## meta-canopy/meta-hpe/meta-gxp/conf/machine/include/gxp-flash-layout.inc
```bitbake
# GXP BMC Flash Partition Layout

# GXP SoC fixed constants
FLASH_SIZE = "32256"
FLASH_UBOOT_OFFSET = "0"
FLASH_KERNEL_OFFSET = "512"

FLASH_UBOOT_SIZE = "384"
FLASH_UBOOT_ENV_OFFSET = "448"
FLASH_UBOOT_ENV_SIZE = "128"
FLASH_UBOOT_SIG_SIZE = "64"
FLASH_GXP_BOOTBLOCK_SIZE = "256"
FLASH_GXP_CKB_SIZE = "256"

# Full ROM size (BMC + bootblock + CKB = 32 MiB)
FLASH_ROM_SIZE = "32768"

# Offset where the uboot-sig partition starts (= FLASH_SIZE - SIG_SIZE)
FLASH_UBOOT_SIG_OFFSET = "32192"

# Offset where the GXP hardware section starts (= FLASH_SIZE)
FLASH_GXP_OFFSET = "32256"

# Tunable partition boundaries
FLASH_ROFS_OFFSET ?= "5376"
FLASH_RWFS_OFFSET ?= "32000"
```

## meta-canopy/meta-hpe/meta-gxp/conf/machine/include/gxp.inc
```bitbake
#@TYPE: Machine
#@NAME: HPE GXP
#@DESCRIPTION: Common machine configuration for the HPE GXP Chip

require conf/machine/include/hpe_soc.inc
require conf/machine/include/gxp-flash-layout.inc

UBOOT_ARCH ?= "arm"

DISTRO_FEATURES ?= "ipv4 ipv6"

SOC_FAMILY = "gxp-b1"
include conf/machine/include/soc-family.inc
MACHINEOVERRIDES .= ":gxp"

require conf/machine/include/arm/armv7a/tune-cortexa9.inc

AVAILTUNES += "cortexa9t-novfp"
TUNE_FEATURES:tune-cortexa9t-novfp = "arm thumb cortexa9"
TUNE_CCARGS .= "${@bb.utils.contains('TUNE_FEATURES', 'cortexa9', ' -mcpu=cortex-a9', '', d)}"
ARMPKGARCH:tune-cortexa9t-novfp = "cortexa9"
PACKAGE_EXTRA_ARCHS:tune-cortexa9t-novfp = "${PACKAGE_EXTRA_ARCHS:tune-armv7at} cortexa9-vfp cortexa9t2 cortexa9t2-vfp"

DEFAULTTUNE = "cortexa9t-novfp"

UBOOT_MACHINE ?= "gxp_defconfig"
UBOOT_ENTRYPOINT ?= "0x40100000"
UBOOT_LOADADDRESS ?= "0x40100000"
UBOOT_DTB_LOADADDRESS ?= "0x48000000"
UBOOT_DTBO_LOADADDRESS ?= "0x48100000"

SERIAL_CONSOLES ?= "115200;ttyS2"

MACHINE_FEATURES += "\
    obmc-phosphor-chassis-mgmt \
    obmc-phosphor-fan-mgmt \
    obmc-phosphor-flash-mgmt \
    obmc-host-state-mgmt \
    obmc-chassis-state-mgmt \
    obmc-bmc-state-mgmt \
    obmc-host-ipmi \
    "

VIRTUAL-RUNTIME_obmc-host-state-manager ?= "x86-power-control"
VIRTUAL-RUNTIME_obmc-chassis-state-manager ?= "x86-power-control"
VIRTUAL-RUNTIME_obmc-sensors-hwmon = "dbus-sensors"
VIRTUAL-RUNTIME_obmc-fan-control = "phosphor-pid-control"

# HPE packagegroup providers
PREFERRED_PROVIDER_virtual/obmc-chassis-mgmt = "packagegroup-hpe-apps"
PREFERRED_PROVIDER_virtual/obmc-fan-mgmt = "packagegroup-hpe-apps"
PREFERRED_PROVIDER_virtual/obmc-flash-mgmt = "packagegroup-hpe-apps"
PREFERRED_PROVIDER_virtual/obmc-system-mgmt = "packagegroup-hpe-apps"
PREFERRED_PROVIDER_virtual/obmc-host-ipmi-hw = "phosphor-ipmi-kcs"
```

## meta-canopy/meta-hpe/meta-gxp/conf/machine/include/hpe_soc.inc
```bitbake
PREFERRED_PROVIDER_virtual/kernel ?= "linux-stable"

# FIT images are now built by the linux-yocto-fitimage recipe
# The kernel itself builds a standard image type (zImage for ARM)
KERNEL_CLASSES ?= "kernel-fit-extra-artifacts"
KERNEL_IMAGETYPE ?= "zImage"
KERNEL_IMAGETYPES ?= "zImage"
FIT_KERNEL_SIGN_ENABLE = "1"
FIT_HASH_ALG = "sha512"
FIT_SIGN_ALG = "rsa4096"
UBOOT_SIGN_ENABLE = "1"
UBOOT_SIGN_KEYNAME = "hpe_fit"
```

## meta-canopy/meta-hpe/meta-gxp/recipes-kernel/linux/linux-stable-6.18/defconfig
```kconfig
CONFIG_KERNEL_XZ=y
CONFIG_DEFAULT_HOSTNAME="gxp"
CONFIG_SYSVIPC=y
CONFIG_NO_HZ=y
CONFIG_HIGH_RES_TIMERS=y
CONFIG_LOG_BUF_SHIFT=16
CONFIG_CGROUPS=y
CONFIG_MEMCG=y
CONFIG_CGROUP_SCHED=y
CONFIG_CGROUP_PIDS=y
CONFIG_CGROUP_FREEZER=y
CONFIG_CGROUP_DEVICE=y
CONFIG_CGROUP_CPUACCT=y
CONFIG_BLK_DEV_INITRD=y
CONFIG_CC_OPTIMIZE_FOR_SIZE=y
CONFIG_ARCH_HPE=y
CONFIG_ARCH_HPE_GXP=y
# CONFIG_ATAGS is not set
# CONFIG_SUSPEND is not set
# CONFIG_COMPAT_BRK is not set
CONFIG_KSM=y
CONFIG_NET=y
CONFIG_PACKET=y
CONFIG_UNIX=y
CONFIG_INET=y
CONFIG_VLAN_8021Q=y
CONFIG_NET_NCSI=y
CONFIG_DEVTMPFS=y
CONFIG_DEVTMPFS_MOUNT=y
# CONFIG_STANDALONE is not set
CONFIG_MTD=y
CONFIG_MTD_BLOCK=y
CONFIG_MTD_PHYSMAP=y
CONFIG_MTD_PHYSMAP_OF=y
CONFIG_MTD_PLATRAM=y
CONFIG_MTD_SPI_NOR=y
CONFIG_OF_OVERLAY=y
CONFIG_BLK_DEV_LOOP=y
CONFIG_BLK_DEV_RAM=y
CONFIG_EEPROM_AT24=y
CONFIG_SCSI=y
CONFIG_BLK_DEV_SD=y
# CONFIG_SCSI_LOWLEVEL is not set
CONFIG_NETDEVICES=y
CONFIG_GXP_UMAC=y
CONFIG_MARVELL_PHY=y
CONFIG_INPUT_EVDEV=y
CONFIG_KEYBOARD_GPIO_POLLED=y
# CONFIG_INPUT_MOUSE is not set
# CONFIG_LEGACY_PTYS is not set
CONFIG_SERIAL_8250=y
# CONFIG_SERIAL_8250_DEPRECATED_OPTIONS is not set
CONFIG_SERIAL_8250_CONSOLE=y
CONFIG_SERIAL_8250_EXTENDED=y
CONFIG_SERIAL_8250_GXP_VUART=y
CONFIG_SERIAL_8250_SHARE_IRQ=y
CONFIG_SERIAL_OF_PLATFORM=y
CONFIG_I2C=y
CONFIG_I2C_CHARDEV=y
CONFIG_I2C_MUX=y
CONFIG_I2C_MUX_REG=y
CONFIG_I2C_MUX_GPMUX=y
CONFIG_MULTIPLEXER=y
CONFIG_MUX_MMIO=y
CONFIG_I2C_GXP=y
CONFIG_SPI=y
CONFIG_SPI_GXP=y
# CONFIG_PTP_1588_CLOCK is not set
CONFIG_GPIOLIB=y
CONFIG_GPIO_GXP=y
CONFIG_SENSORS_GXP_FAN_CTRL=y
CONFIG_SENSORS_GXP_CORETEMP=y
CONFIG_SENSORS_PECI_CPUTEMP=y
CONFIG_SENSORS_PECI_DIMMTEMP=y
CONFIG_WATCHDOG=y
CONFIG_GXP_WATCHDOG=y
CONFIG_REGULATOR=y
CONFIG_REGULATOR_GXP_CPLD=y
CONFIG_USB=y
CONFIG_USB_EHCI_HCD=y
CONFIG_USB_EHCI_ROOT_HUB_TT=y
CONFIG_USB_OHCI_HCD=y
CONFIG_USB_OHCI_HCD_PLATFORM=y
CONFIG_USB_STORAGE=y
CONFIG_NEW_LEDS=y
CONFIG_LEDS_CLASS=y
CONFIG_LEDS_GPIO=y
CONFIG_LEDS_TRIGGERS=y
CONFIG_LEDS_TRIGGER_HEARTBEAT=y
CONFIG_LEDS_TRIGGER_DEFAULT_ON=y
CONFIG_SOC_HPE=y
CONFIG_SOC_HPE_GXP_CSM=y
CONFIG_SOC_HPE_GXP_XREG=y
CONFIG_SOC_HPE_GXP_FN2=y
CONFIG_SOC_HPE_GXP_POWER_CTRL=y
CONFIG_SOC_HPE_GXP_CHIF=y
CONFIG_NVMEM_HPE_GXP=y
CONFIG_PECI=y
CONFIG_PECI_GXP=y
CONFIG_OVERLAY_FS=y
CONFIG_TMPFS=y
CONFIG_TMPFS_POSIX_ACL=y
CONFIG_JFFS2_FS=y
CONFIG_JFFS2_SUMMARY=y
CONFIG_SQUASHFS=y
CONFIG_SQUASHFS_XZ=y
CONFIG_NLS_CODEPAGE_437=y
CONFIG_NLS_ASCII=y
CONFIG_NLS_ISO8859_1=y
CONFIG_NLS_UTF8=y
CONFIG_PRINTK_TIME=y
CONFIG_DYNAMIC_DEBUG=y
CONFIG_DEBUG_KERNEL=y
CONFIG_MAGIC_SYSRQ=y
CONFIG_DEBUG_LL=y
CONFIG_DEBUG_LL_UART_8250=y
CONFIG_DEBUG_UART_PHYS=0xC00000F0
CONFIG_DEBUG_UART_VIRT=0xF00000F0
CONFIG_DEBUG_UART_8250_SHIFT=0
CONFIG_EARLY_PRINTK=y
# AMD specific
CONFIG_AMD_SBRMI_I2C=y
CONFIG_AMD_SBRMI_HWMON=y
CONFIG_SENSORS_SBTSI=y
CONFIG_SENSORS_SPD5118=y
```
